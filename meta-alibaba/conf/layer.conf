## meta-alibaba/meta-obmc-rj/meta-obmc-wb/conf/layer.conf
```bitbake
# We have a conf and classes directory, add to BBPATH
BBPATH .= ":${LAYERDIR}"

# We have recipes-* directories, add to BBFILES
BBFILES += "${LAYERDIR}/recipes-*/*/*.bb \
	${LAYERDIR}/recipes-*/*/*.bbappend \
    ${LAYERDIR}/recipes-product/*/*/*.bb \
    ${LAYERDIR}/recipes-product/*/*/*.bbappend \
    ${LAYERDIR}/recipes-custom/alibaba/*/*.bb \
    ${LAYERDIR}/recipes-custom/alibaba/*/*.bbappend \
	"

BBFILE_COLLECTIONS += "obmc-wb"
BBFILE_PATTERN_obmc-wb = "^${LAYERDIR}/"
BBFILE_PRIORITY_obmc-wb = "25"

DISTRO_FEATURES:append = " systemd usrmerge"
VIRTUAL-RUNTIME_init_manager = "systemd"
DISTRO_FEATURES_BACKFILL_CONSIDERED += "sysvinit"
VIRTUAL-RUNTIME_initscripts = "systemd-compat-units"
```

## meta-alibaba/meta-obmc-rj/meta-platform/meta-general-ast2600/conf/layer.conf
```bitbake
# We have a conf and classes directory, add to BBPATH
BBPATH .= ":${LAYERDIR}"

BBFILE_COLLECTIONS += "general-ast2600"
BBFILE_PATTERN_general-ast2600 := "^${LAYERDIR}/"
BBFILE_PRIORITY_general-ast2600 = "27"
LAYERSERIES_COMPAT_general-ast2600 = "scarthgap nanbield kirkstone dunfell"

# We have recipes-* directories, add to BBFILES
BBFILES += "${LAYERDIR}/../recipes-product/recipes-AS15-24D8O-RJ/*/*.bb \
            ${LAYERDIR}/../recipes-product/recipes-AS15-24D8O-RJ/*/*.bbappend \
            ${LAYERDIR}/../recipes-product/recipes-AS25-128Q-RJ/*/*.bb \
            ${LAYERDIR}/../recipes-product/recipes-AS25-128Q-RJ/*/*.bbappend \
            ${LAYERDIR}/../recipes-product/recipes-AS15-40Q-RJ/*/*.bb \
            ${LAYERDIR}/../recipes-product/recipes-AS15-40Q-RJ/*/*.bbappend \
            ${LAYERDIR}/recipes-*/*/*.bb \
            ${LAYERDIR}/recipes-*/*/*.bbappend \
            "
```

## meta-alibaba/meta-obmc-rj/meta-platform/meta-general-ast2600/conf/machine/include/whitebox_custom.inc
```bitbake
KERNEL_DEVICETREE = "aspeed-bmc-as15-24d8o.dtb \
                     aspeed-bmc-as25-128q.dtb \
                     aspeed-bmc-as15-40q.dtb \
                    "

require conf/machine/include/ast2620.inc

UBOOT_MACHINE = "wb-ast2600-9600_config"
DEFAULT_TIMEZONE = "Asia/Shanghai"
SERIAL_CONSOLES = "9600;ttyS4"
```
